## meta-rpi-bsp/conf/machine/rpi02w64.conf
```bitbake
#Machine configuration

#@TYPE: Machine
#@NAME: rpi02w64.conf
#@DESCRIPTION: Raspberrypi02w, SOC 64bits, BCM2710A1, 512Mo

require conf/machine/raspberrypi0-2w-64.conf

#machine features
MACHINE_FEATURES = " apm usbhost vfat ext2 bluetooth wifi sdio"


#prefered provide (KERNEL)
PREFERRED_PROVIDER_virtual/kernel ?= "linux-raspberrypi"

#Use Uboot as bootloader
RPI_USE_U_BOOT = "1"

#enable uart
ENABLE_UART ="1"

#kernel deviceTree
KERNEL_DEVICETREE = "\
                     broadcom/bcm2710-rpi-zero-2.dtb \
                     overlays/overlay_map.dtb \
                     "
                     
#image type (wic) {ext4 for rootfs partition /vfat for boot partition}
IMAGE_FSTYPES ="wic ext4"
```
